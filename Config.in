## audio/Config.in
```kconfig
source "$BR2_EXTERNAL_MP_AUDIO_PATH/package/raat/Config.in"
source "$BR2_EXTERNAL_MP_AUDIO_PATH/package/mpcodec/Config.in"
```

## audio/configs/mp_defconfig
```kconfig
BR2_arm=y
BR2_cortex_a7=y
BR2_ARM_FPU_NEON_VFPV4=y
BR2_CCACHE=y
BR2_GLOBAL_PATCH_DIR="$(BR2_EXTERNAL_MP_AUDIO_PATH)/patches"
BR2_TOOLCHAIN_EXTERNAL=y
BR2_TOOLCHAIN_EXTERNAL_LINARO_ARM=y
BR2_TARGET_GENERIC_HOSTNAME="mp"
BR2_TARGET_GENERIC_ISSUE="Welcome to Musica Pristina"
BR2_ROOTFS_DEVICE_CREATION_DYNAMIC_MDEV=y
BR2_TARGET_TZ_INFO=y
BR2_TARGET_LOCALTIME="America/New_York"
BR2_ROOTFS_USERS_TABLES="$(BR2_EXTERNAL_MP_AUDIO_PATH)/users.txt"
BR2_ROOTFS_OVERLAY="$(BR2_EXTERNAL_MP_AUDIO_PATH)/overlay"
BR2_ROOTFS_POST_BUILD_SCRIPT="$(BR2_EXTERNAL_MP_AUDIO_PATH)/post_build.sh"
BR2_ROOTFS_POST_IMAGE_SCRIPT="$(BR2_EXTERNAL_MP_AUDIO_PATH)/post_image.sh"
BR2_LINUX_KERNEL=y
BR2_LINUX_KERNEL_DEFCONFIG="imx_v6_v7"
BR2_LINUX_KERNEL_CONFIG_FRAGMENT_FILES="$(BR2_EXTERNAL_MP_AUDIO_PATH)/board/colibri-imx7/linux.configfrag"
BR2_LINUX_KERNEL_DTS_SUPPORT=y
BR2_LINUX_KERNEL_INTREE_DTS_NAME="imx7d-colibri-emmc-eval-v3"
BR2_PACKAGE_LINUX_TOOLS_GPIO=y
BR2_PACKAGE_BUSYBOX_CONFIG_FRAGMENT_FILES="$(BR2_EXTERNAL_MP_AUDIO_PATH)/configs/busybox.configfrag"
BR2_PACKAGE_ALSA_UTILS=y
BR2_PACKAGE_ALSA_UTILS_ALSACONF=y
BR2_PACKAGE_ALSA_UTILS_AMIXER=y
BR2_PACKAGE_ALSA_UTILS_APLAY=y
BR2_PACKAGE_ALSA_UTILS_SPEAKER_TEST=y
BR2_PACKAGE_FFMPEG_FFPROBE=y
BR2_PACKAGE_FFMPEG_SWSCALE=y
BR2_PACKAGE_MPD=y
BR2_PACKAGE_MPD_SQLITE=y
BR2_PACKAGE_MPD_SOUNDCLOUD=y
BR2_PACKAGE_MPD_LIBSOXR=y
BR2_PACKAGE_MPD_AUDIOFILE=y
BR2_PACKAGE_MPD_DSD=y
BR2_PACKAGE_MPD_FAAD2=y
BR2_PACKAGE_MPD_FFMPEG=y
BR2_PACKAGE_MPD_FLAC=y
BR2_PACKAGE_MPD_LIBSNDFILE=y
BR2_PACKAGE_MPD_MPG123=y
BR2_PACKAGE_MPD_MUSEPACK=y
BR2_PACKAGE_MPD_OPUS=y
BR2_PACKAGE_MPD_VORBIS=y
BR2_PACKAGE_MPD_WAVPACK=y
BR2_PACKAGE_MPD_LIBNFS=y
BR2_PACKAGE_MPD_LIBSMBCLIENT=y
BR2_PACKAGE_MPD_AVAHI_SUPPORT=y
BR2_PACKAGE_MPD_LIBMPDCLIENT=y
BR2_PACKAGE_MPD_UPNP=y
BR2_PACKAGE_MPD_MPC=y
BR2_PACKAGE_UPMPDCLI=y
BR2_PACKAGE_GIT=y
BR2_PACKAGE_CIFS_UTILS=y
BR2_PACKAGE_MTD=y
BR2_PACKAGE_UBOOT_TOOLS=y
BR2_PACKAGE_NODEJS=y
BR2_PACKAGE_NODEJS_NPM=y
BR2_PACKAGE_LIBSAMPLERATE=y
BR2_PACKAGE_CA_CERTIFICATES=y
BR2_PACKAGE_REDIS=y
BR2_PACKAGE_LIBGPIOD=y
BR2_PACKAGE_LIBGPIOD_TOOLS=y
BR2_PACKAGE_LIBSOUP=y
BR2_PACKAGE_LIBUPNP=y
BR2_PACKAGE_GLIBMM=y
BR2_PACKAGE_HAVEGED=y
BR2_PACKAGE_CONNMAN=y
BR2_PACKAGE_CONNMAN_WIFI=y
BR2_PACKAGE_CONNMAN_BLUETOOTH=y
BR2_PACKAGE_CONNMAN_CLIENT=y
BR2_PACKAGE_DROPBEAR=y
BR2_PACKAGE_DROPBEAR_DISABLE_REVERSEDNS=y
BR2_PACKAGE_SHAIRPORT_SYNC=y
BR2_PACKAGE_SHAIRPORT_SYNC_LIBSOXR=y
BR2_PACKAGE_SWUPDATE=y
BR2_PACKAGE_NANO=y
BR2_TARGET_ROOTFS_EXT2=y
BR2_TARGET_ROOTFS_EXT2_4=y
BR2_TARGET_ROOTFS_EXT2_SIZE="1024M"
BR2_TARGET_ROOTFS_EXT2_MKFS_OPTIONS="-O ^64bit -t ext4"
BR2_TARGET_UBOOT=y
BR2_TARGET_UBOOT_BUILD_SYSTEM_KCONFIG=y
BR2_TARGET_UBOOT_CUSTOM_GIT=y
BR2_TARGET_UBOOT_CUSTOM_REPO_URL="git://git.toradex.com/u-boot-toradex.git"
BR2_TARGET_UBOOT_CUSTOM_REPO_VERSION="2016.11-toradex"
BR2_TARGET_UBOOT_BOARD_DEFCONFIG="colibri_imx7_emmc"
BR2_TARGET_UBOOT_NEEDS_DTC=y
# BR2_TARGET_UBOOT_FORMAT_BIN is not set
BR2_TARGET_UBOOT_FORMAT_IMX=y
BR2_PACKAGE_HOST_MTD=y
BR2_PACKAGE_RAAT=y
BR2_PACKAGE_MPCODEC=y
```

## audio/package/mpcodec/Config.in
```kconfig
config BR2_PACKAGE_MPCODEC
	bool "mpcodec"
	depends on BR2_LINUX_KERNEL
	help
	  Kernel driver for MP codec
```

## audio/package/plex-media-player/Config.in
```kconfig
config BR2_PACKAGE_PLEX-MEDIA-PLAYER
    bool "PLEX-MEDIA-PLAYER"
    help
      This is a comment that explains what PLEX-MEDIA-PLAYER is. The help text
      should be wrapped.
      
      https://github.com/plexinc/plex-media-player
```

## audio/package/raat/Config.in
```kconfig
config BR2_PACKAGE_RAAT
    bool "raat"
    help
      This is a comment that explains what raat is. The help text
      should be wrapped.
      
      http://roonlabs.com/
```

## buildroot-upnp/colibri_imx7_defconfig
```kconfig
BR2_arm=y
BR2_cortex_a7=y
BR2_ARM_FPU_NEON_VFPV4=y
BR2_TOOLCHAIN_EXTERNAL=y
BR2_TOOLCHAIN_EXTERNAL_LINARO_ARM=y
BR2_LINUX_KERNEL=y
BR2_LINUX_KERNEL_CUSTOM_GIT=y
BR2_LINUX_KERNEL_CUSTOM_REPO_URL="https://github.com/kdubious/linux-toradex.git"
BR2_LINUX_KERNEL_CUSTOM_REPO_VERSION="toradex_4.9-2.3.x-imx"
# BR2_LINUX_KERNEL_USE_CUSTOM_CONFIG is not set
BR2_LINUX_KERNEL_USE_DEFCONFIG=y
BR2_LINUX_KERNEL_DEFCONFIG="colibri_imx7"
BR2_LINUX_KERNEL_CONFIG_FRAGMENT_FILES="$(BR2_EXTERNAL_UPNP_PATH)/board/colibri-imx7/linux.configfrag"
BR2_LINUX_KERNEL_DTS_SUPPORT=y
BR2_LINUX_KERNEL_INTREE_DTS_NAME="imx7d-colibri-eval-v3"
BR2_LINUX_KERNEL_INSTALL_TARGET=y
BR2_TARGET_ROOTFS_TAR_XZ=y
BR2_TARGET_ROOTFS_UBIFS=y
BR2_TARGET_ROOTFS_UBIFS_LEBSIZE=0x20000
BR2_TARGET_ROOTFS_UBIFS_XZ=y
BR2_TARGET_UBOOT=y
BR2_TARGET_UBOOT_BUILD_SYSTEM_KCONFIG=y
BR2_TARGET_UBOOT_CUSTOM_GIT=y
BR2_TARGET_UBOOT_CUSTOM_REPO_URL="git://git.toradex.com/u-boot-toradex.git"
BR2_TARGET_UBOOT_CUSTOM_REPO_VERSION="2016.11-toradex"
BR2_TARGET_UBOOT_BOARD_DEFCONFIG="colibri_imx7"
BR2_TARGET_UBOOT_NEEDS_DTC=y
# BR2_TARGET_UBOOT_FORMAT_BIN is not set
BR2_TARGET_UBOOT_FORMAT_CUSTOM=y
BR2_TARGET_UBOOT_FORMAT_CUSTOM_NAME="u-boot-nand.imx"
BR2_PACKAGE_HOST_MTD=y
```

## buildroot-upnp/package/plex/Config.in
```kconfig
config BR2_PACKAGE_PLEX
    bool "plex"
    help
      This is a comment that explains what plex is. The help text
      should be wrapped.
      
      http://plex.tv/
```

## buildroot-upnp/qemu_virt_defconfig
```kconfig
# Architecture
BR2_arm=y
BR2_cortex_a9=y
BR2_ARM_ENABLE_NEON=y
BR2_ARM_ENABLE_VFP=y
BR2_TOOLCHAIN_EXTERNAL=y
BR2_TOOLCHAIN_EXTERNAL_LINARO_ARM=y

# System
BR2_SYSTEM_DHCP="eth0"
BR2_TARGET_GENERIC_GETTY_PORT="ttyAMA0"

# Filesystem
BR2_TARGET_ROOTFS_EXT2=y
BR2_TARGET_ROOTFS_EXT2_4=y
BR2_TARGET_ROOTFS_EXT2_SIZE="512M"
# BR2_TARGET_ROOTFS_TAR is not set

# Linux headers same as kernel, a 4.19 series
BR2_PACKAGE_HOST_LINUX_HEADERS_CUSTOM_4_19=y

# Kernel
BR2_LINUX_KERNEL=y
BR2_LINUX_KERNEL_CUSTOM_VERSION=y
BR2_LINUX_KERNEL_CUSTOM_VERSION_VALUE="4.19.16"
BR2_LINUX_KERNEL_USE_DEFCONFIG=y
BR2_LINUX_KERNEL_DEFCONFIG="vexpress"
BR2_LINUX_KERNEL_CONFIG_FRAGMENT_FILES="$(BR2_EXTERNAL_UPNP_PATH)/board/qemu-virt/linux.configfrag"
BR2_LINUX_KERNEL_DTS_SUPPORT=y
BR2_LINUX_KERNEL_INTREE_DTS_NAME="vexpress-v2p-ca9"
```

## buildroot-upnp/upnp_defconfig
```kconfig
BR2_CCACHE=y
# BR2_ROOTFS_DEVICE_CREATION_DYNAMIC_DEVTMPFS is not set
BR2_ROOTFS_DEVICE_CREATION_DYNAMIC_MDEV=y
BR2_PACKAGE_ALSA_UTILS=y
BR2_PACKAGE_ALSA_UTILS_APLAY=y
BR2_PACKAGE_ALSA_UTILS_SPEAKER_TEST=y
BR2_PACKAGE_CA_CERTIFICATES=y
BR2_PACKAGE_MPD=y
BR2_PACKAGE_MPD_LIBSAMPLERATE=y
BR2_PACKAGE_MPD_LIBSOXR=y
BR2_PACKAGE_MPD_AUDIOFILE=y
BR2_PACKAGE_MPD_DSD=y
BR2_PACKAGE_MPD_FAAD2=y
BR2_PACKAGE_MPD_FFMPEG=y
BR2_PACKAGE_MPD_FLAC=y
BR2_PACKAGE_MPD_LIBSNDFILE=y
BR2_PACKAGE_MPD_MUSEPACK=y
BR2_PACKAGE_MPD_OPUS=y
BR2_PACKAGE_MPD_TREMOR=y
BR2_PACKAGE_MPD_VORBIS=y
BR2_PACKAGE_MPD_WAVPACK=y
BR2_PACKAGE_MPD_CURL=y
BR2_PACKAGE_MPD_LIBMPDCLIENT=y
BR2_PACKAGE_UPMPDCLI=y
BR2_PACKAGE_GIT=y
BR2_PACKAGE_NODEJS=y
BR2_PACKAGE_NODEJS_NPM=y
BR2_PACKAGE_MTD=y
BR2_PACKAGE_HAVEGED=y
BR2_PACKAGE_DROPBEAR=y
BR2_PACKAGE_DROPBEAR_DISABLE_REVERSEDNS=y
BR2_PACKAGE_NANO=y
BR2_TARGET_GENERIC_HOSTNAME="musicapristina"
BR2_TARGET_GENERIC_ISSUE="Welcome to Musica Pristina"
BR2_PACKAGE_BUSYBOX_CONFIG_FRAGMENT_FILES="$(BR2_EXTERNAL_UPNP_PATH)/busybox.configfrag"
BR2_ROOTFS_OVERLAY="$(BR2_EXTERNAL_UPNP_PATH)/overlay"
BR2_GLOBAL_PATCH_DIR="$(BR2_EXTERNAL_UPNP_PATH)/patches"
BR2_ROOTFS_USERS_TABLES="$(BR2_EXTERNAL_UPNP_PATH)/users.txt"
BR2_PACKAGE_RAAT=y
```

## configs/colibri-imx7_defconfig
```kconfig
BR2_arm=y
BR2_cortex_a7=y
BR2_ARM_FPU_NEON_VFPV4=y
BR2_CCACHE=y
BR2_TOOLCHAIN_EXTERNAL=y
BR2_TOOLCHAIN_EXTERNAL_LINARO_ARM=y
BR2_TARGET_GENERIC_HOSTNAME="musicapristina"
BR2_TARGET_GENERIC_ISSUE="Welcome to Musica Pristina"
BR2_SYSTEM_BIN_SH_BASH=y
BR2_TARGET_TZ_INFO=y
BR2_ROOTFS_OVERLAY="$(BR2_EXTERNAL_MusicaPristina_PATH)/board/toradex/colibri-imx7/overlay/"
BR2_LINUX_KERNEL=y
BR2_LINUX_KERNEL_CUSTOM_GIT=y
BR2_LINUX_KERNEL_CUSTOM_REPO_URL="https://github.com/kdubious/linux-toradex.git"
BR2_LINUX_KERNEL_CUSTOM_REPO_VERSION="toradex_4.9-2.3.x-imx"
BR2_LINUX_KERNEL_USE_CUSTOM_CONFIG=y
BR2_LINUX_KERNEL_CUSTOM_CONFIG_FILE="$(BR2_EXTERNAL_MusicaPristina_PATH)/configs/kernel.config"
BR2_LINUX_KERNEL_DTS_SUPPORT=y
BR2_LINUX_KERNEL_INTREE_DTS_NAME="imx7d-colibri-eval-v3"
BR2_LINUX_KERNEL_INSTALL_TARGET=y
BR2_PACKAGE_LINUX_TOOLS_GPIO=y
BR2_PACKAGE_BUSYBOX_SHOW_OTHERS=y
BR2_PACKAGE_ALSA_UTILS=y
BR2_PACKAGE_ALSA_UTILS_APLAY=y
BR2_PACKAGE_ALSA_UTILS_SPEAKER_TEST=y
BR2_PACKAGE_MPD=y
BR2_PACKAGE_MPD_DSD=y
BR2_PACKAGE_MPD_FLAC=y
BR2_PACKAGE_MPD_UPNP=y
BR2_PACKAGE_CIFS_UTILS=y
BR2_PACKAGE_NODEJS=y
BR2_PACKAGE_NODEJS_NPM=y
BR2_PACKAGE_NANO=y
BR2_TARGET_ROOTFS_UBIFS=y
BR2_TARGET_ROOTFS_UBIFS_LEBSIZE=0x20000
BR2_TARGET_UBOOT=y
BR2_TARGET_UBOOT_BUILD_SYSTEM_KCONFIG=y
BR2_TARGET_UBOOT_CUSTOM_GIT=y
BR2_TARGET_UBOOT_CUSTOM_REPO_URL="git://git.toradex.com/u-boot-toradex.git"
BR2_TARGET_UBOOT_CUSTOM_REPO_VERSION="2016.11-toradex"
BR2_TARGET_UBOOT_BOARD_DEFCONFIG="colibri_imx7"
# BR2_TARGET_UBOOT_FORMAT_BIN is not set
BR2_TARGET_UBOOT_FORMAT_IMX=y
BR2_PACKAGE_HOST_MTD=y
```

## configs/upnp_defconfig
```kconfig
BR2_CCACHE=y
BR2_PACKAGE_ALSA_UTILS=y
BR2_PACKAGE_GMRENDER_RESURRECT=y
BR2_PACKAGE_GST1_PLUGINS_BASE_PLUGIN_AUDIORATE=y
# BR2_PACKAGE_GST1_PLUGINS_BASE_PLUGIN_VIDEOSCALE is not set
BR2_PACKAGE_GST1_PLUGINS_BASE_PLUGIN_ALSA=y
BR2_PACKAGE_GST1_PLUGINS_BASE_PLUGIN_TREMOR=y
BR2_PACKAGE_GST1_PLUGINS_BASE_PLUGIN_OGG=y
BR2_PACKAGE_GST1_PLUGINS_BASE_PLUGIN_OPUS=y
BR2_PACKAGE_GST1_PLUGINS_BASE_PLUGIN_VORBIS=y
BR2_PACKAGE_GST1_PLUGINS_GOOD=y
BR2_PACKAGE_GST1_PLUGINS_GOOD_PLUGIN_AUDIOPARSERS=y
BR2_PACKAGE_GST1_PLUGINS_GOOD_PLUGIN_AUPARSE=y
BR2_PACKAGE_GST1_PLUGINS_GOOD_PLUGIN_ICYDEMUX=y
BR2_PACKAGE_GST1_PLUGINS_GOOD_PLUGIN_ID3DEMUX=y
BR2_PACKAGE_GST1_PLUGINS_GOOD_PLUGIN_INTERLEAVE=y
BR2_PACKAGE_GST1_PLUGINS_GOOD_PLUGIN_MPG123=y
BR2_PACKAGE_GST1_PLUGINS_GOOD_PLUGIN_FLAC=y
BR2_PACKAGE_GST1_PLUGINS_GOOD_PLUGIN_SOUPHTTPSRC=y
BR2_PACKAGE_GST1_PLUGINS_GOOD_PLUGIN_TAGLIB=y
BR2_PACKAGE_GST1_PLUGINS_GOOD_PLUGIN_WAVPACK=y
BR2_PACKAGE_GST1_PLUGINS_BAD=y
BR2_PACKAGE_GST1_PLUGINS_BAD_PLUGIN_AIFF=y
BR2_PACKAGE_GST1_PLUGINS_BAD_PLUGIN_AUTOCONVERT=y
BR2_PACKAGE_GST1_PLUGINS_BAD_PLUGIN_ID3TAG=y
BR2_PACKAGE_GST1_PLUGINS_BAD_PLUGIN_CURL=y
BR2_PACKAGE_GST1_PLUGINS_BAD_PLUGIN_FAAD=y
BR2_PACKAGE_GST1_PLUGINS_BAD_PLUGIN_FDK_AAC=y
BR2_PACKAGE_GST1_PLUGINS_BAD_PLUGIN_HLS=y
BR2_PACKAGE_GST1_PLUGINS_BAD_PLUGIN_MUSEPACK=y
BR2_PACKAGE_GST1_PLUGINS_BAD_PLUGIN_OPUS=y
BR2_PACKAGE_GST1_PLUGINS_BAD_PLUGIN_SNDFILE=y
BR2_PACKAGE_GST1_PLUGINS_UGLY=y
BR2_PACKAGE_GST1_PLUGINS_UGLY_PLUGIN_ASFDEMUX=y
BR2_PACKAGE_GST1_LIBAV=y
BR2_PACKAGE_MPD=y
BR2_PACKAGE_MPD_LIBSAMPLERATE=y
BR2_PACKAGE_MPD_LIBSOXR=y
BR2_PACKAGE_MPD_AUDIOFILE=y
BR2_PACKAGE_MPD_DSD=y
BR2_PACKAGE_MPD_FAAD2=y
BR2_PACKAGE_MPD_FFMPEG=y
BR2_PACKAGE_MPD_FLAC=y
BR2_PACKAGE_MPD_LIBSNDFILE=y
BR2_PACKAGE_MPD_MUSEPACK=y
BR2_PACKAGE_MPD_OPUS=y
BR2_PACKAGE_MPD_TREMOR=y
BR2_PACKAGE_MPD_VORBIS=y
BR2_PACKAGE_MPD_WAVPACK=y
BR2_PACKAGE_MPD_CURL=y
BR2_PACKAGE_MPD_LIBMPDCLIENT=y
BR2_PACKAGE_UPMPDCLI=y
BR2_PACKAGE_GIT=y
BR2_PACKAGE_MTD=y
BR2_PACKAGE_HAVEGED=y
BR2_PACKAGE_DROPBEAR=y
BR2_PACKAGE_DROPBEAR_DISABLE_REVERSEDNS=y
BR2_PACKAGE_NANO=y
BR2_TARGET_GENERIC_HOSTNAME="musicapristina"
BR2_TARGET_GENERIC_ISSUE="Welcome to Musica Pristina"
BR2_PACKAGE_BUSYBOX_CONFIG_FRAGMENT_FILES="$(BR2_EXTERNAL_UPNP_PATH)/board/toradex/colibri-imx7/busybox.configfrag"
BR2_ROOTFS_OVERLAY="$(BR2_EXTERNAL_UPNP_PATH)/board/toradex/colibri-imx7/rootfs_overlay"
BR2_GLOBAL_PATCH_DIR="$(BR2_EXTERNAL_UPNP_PATH)/board/toradex/colibri-imx7/patches"
BR2_ROOTFS_USERS_TABLES="$(BR2_EXTERNAL_UPNP_PATH)/configs/users.txt"
```
